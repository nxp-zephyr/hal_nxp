## CMakeLists.txt
```
# SPDX-License-Identifier: Apache-2.0

cmake_minimum_required(VERSION 3.20.0)

find_package(Zephyr REQUIRED HINTS $ENV{ZEPHYR_BASE})
project(wireless_uart)

FILE(GLOB app_sources src/wu.c
                      src/wireless_uart.c
                      src/main.c)
target_sources(app PRIVATE
  ${app_sources}
  )
```

## Kconfig
```
# Copyright (c) 2021 Nordic Semiconductor ASA
# SPDX-License-Identifier: Apache-2.0

mainmenu "Bluetooth: Wireless Uart"

if HAS_HW_NRF_TEMP

config SENSOR
	default y

config TEMP_NRF5
	default y

endif # HAS_HW_NRF_TEMP

config WU_CLIENT
	bool "App set to client role"
	default n
	help
	  If enabled, the app start with client role.

source "Kconfig.zephyr"
```

## sample.yaml
```
sample:
  name: Bluetooth Wireless Uart
  description: Demonstrates the Wireless Uart GATT Service
tests:
  sample.bluetooth.wireless_uart:
    harness: bluetooth
    platform_allow:
      - rd_rw612_bga
    tags: bluetooth
    integration_platforms:
      - rd_rw612_bga
```

## prj.conf
```kconfig
CONFIG_BT=y
CONFIG_LOG=y
CONFIG_BT_SMP=y
CONFIG_BT_PERIPHERAL=y
CONFIG_BT_CENTRAL=y
CONFIG_BT_GATT_CLIENT=y
CONFIG_BT_DIS=y
CONFIG_BT_DIS_PNP=n
CONFIG_BT_BAS=y
CONFIG_BT_DEVICE_NAME="Z_Wireless_Uart"
CONFIG_BT_DEVICE_APPEARANCE=768
CONFIG_CBPRINTF_FP_SUPPORT=y
CONFIG_LOG_MODE_IMMEDIATE=y
CONFIG_WU_CLIENT=n
```

## src/main.c
```c
/*
 * Copyright 2019 ~ 2024 NXP
 * All rights reserved.
 *
 * SPDX-License-Identifier: BSD-3-Clause
 *
 * @file
 * @brief Wireless Uart Service Profile
 *
 */

/* -------------------------------------------------------------------------- */
/*                                Includes                                    */
/* -------------------------------------------------------------------------- */

#include "wireless_uart.h"

/* -------------------------------------------------------------------------- */
/*                              Functions                                     */
/* -------------------------------------------------------------------------- */

int main(void)
{
	wireless_uart_start();

	return 0;
}
```

## src/wireless_uart.c
```c
/*
 * Copyright 2019~2024 NXP
 * All rights reserved.
 *
 * SPDX-License-Identifier: BSD-3-Clause
 *
 */

/* -------------------------------------------------------------------------- */
/*                                Includes                                    */
/* -------------------------------------------------------------------------- */

#include <zephyr/bluetooth/gatt.h>
#include "wu.h"


/* -------------------------------------------------------------------------- */
/*                              Function Prototypes                           */
/* -------------------------------------------------------------------------- */

static void connected(struct bt_conn *conn, uint8_t err);
static void disconnected(struct bt_conn *conn, uint8_t reason);
#if CONFIG_BT_SMP
static void security_changed(struct bt_conn *conn, bt_security_t level, enum bt_security_err err);
static void auth_passkey_display(struct bt_conn *conn, unsigned int passkey);
static void auth_cancel(struct bt_conn *conn);
#endif

typedef struct _scan_dev_info_t {
	const bt_addr_le_t *addr;
	uint8_t             ad_type;
	uint8_t             ad_len;
	int8_t              rssi;
} scan_dev_info_t;

/* -------------------------------------------------------------------------- */
/*                            Variable                                        */
/* -------------------------------------------------------------------------- */

#define DEVICE_NAME CONFIG_BT_DEVICE_NAME
#define DEVICE_NAME_LEN (sizeof(DEVICE_NAME) - 1)

#if !defined(CONFIG_WU_CLIENT)
static const struct bt_data ad[] = {
	BT_DATA_BYTES(BT_DATA_FLAGS, (BT_LE_AD_GENERAL | BT_LE_AD_NO_BREDR)),
	BT_DATA_BYTES(BT_DATA_UUID128_SOME, WIRELESS_UART_SERVICE_UUID),
};
static const struct bt_data sd[] = {
	BT_DATA(BT_DATA_NAME_COMPLETE, DEVICE_NAME, DEVICE_NAME_LEN),
};
#endif

static struct bt_conn_cb conn_callbacks = {
	.connected    = connected,
	.disconnected = disconnected,
#if CONFIG_BT_SMP
	.security_changed = security_changed,
#endif
};

#if CONFIG_BT_SMP
static struct bt_conn_auth_cb auth_cb_display = {
	.passkey_display = auth_passkey_display,
	.passkey_entry   = NULL,
	.cancel          = auth_cancel,
};
#endif

/* -------------------------------------------------------------------------- */
/*                              Functions                                     */
/* -------------------------------------------------------------------------- */

static void connected(struct bt_conn *conn, uint8_t err)
{
	char                addr[BT_ADDR_LE_STR_LEN];
	struct bt_conn_info info;

	bt_addr_le_to_str(bt_conn_get_dst(conn), addr, sizeof(addr));

	if (err) {
		printf("Failed to connect %s (err %u)\n", addr, err);
	} else {
		err = bt_conn_get_info(conn, &info);
		if (err) {
			printf("Failed to get info");
			return;
		}

		switch (info.role) {
		case BT_HCI_ROLE_PERIPHERAL:

			break;
		case BT_HCI_ROLE_CENTRAL:

			break;
		}

		bt_gatt_wu_connected(conn);

		printf("Connected to %s\n", addr);

#if CONFIG_BT_SMP
		if (info.role == BT_HCI_ROLE_PERIPHERAL) {
			if (bt_conn_set_security(conn, BT_SECURITY_L2)) {
				printf("Failed to set security\n");
			}
		}
#endif
	}
}

static void disconnected(struct bt_conn *conn, uint8_t reason)
{
	char addr[BT_ADDR_LE_STR_LEN];

	bt_gatt_wu_disconnected(conn);

	bt_addr_le_to_str(bt_conn_get_dst(conn), addr, sizeof(addr));

	printf("Disconnected from %s (reason %u)\n", addr, reason);
}

#if CONFIG_BT_SMP
static void security_changed(struct bt_conn *conn, bt_security_t level, enum bt_security_err err)
{
	char addr[BT_ADDR_LE_STR_LEN];

	bt_addr_le_to_str(bt_conn_get_dst(conn), addr, sizeof(addr));

	printf("Security changed: %s level %u (error %d)\n", addr, level, err);
}

static void auth_passkey_display(struct bt_conn *conn, unsigned int passkey)
{
	char addr[BT_ADDR_LE_STR_LEN];

	bt_addr_le_to_str(bt_conn_get_dst(conn), addr, sizeof(addr));

	printf("Passkey for %s: %06u\n", addr, passkey);
}

static void auth_cancel(struct bt_conn *conn)
{
	char addr[BT_ADDR_LE_STR_LEN];

	bt_addr_le_to_str(bt_conn_get_dst(conn), addr, sizeof(addr));

	printf("Pairing cancelled: %s\n", addr);
}
#endif

static int wireless_uart_data_received(struct bt_conn *conn, uint8_t *buffer, ssize_t length)
{
	char addr[BT_ADDR_LE_STR_LEN];

	bt_addr_le_to_str(bt_conn_get_dst(conn), addr, sizeof(addr));
	printf("Data received from %s(length %d):", addr, length);
	for (int i = 0; i < length; i++) {
		printf("%c", ((uint8_t *)buffer)[i]);
	}
	printf("\r\n");
	return 0;
}

static int wireless_uart_read(struct bt_conn *conn, bt_gatt_wu_read_response_t response, void *param)
{
	uint8_t buffer[13] = {'w', 'i', 'r', 'e', 'l', 'e', 's', 's', ' ', 'u', 'a', 'r', 't'};
	ssize_t length     = 13;

	int ret = -1;

	if (response != NULL) {
		ret = response(param, buffer, length);
	}

	return ret;
}

#ifdef CONFIG_WU_CLIENT
static bool wu_central_parse_callback(struct bt_data *data, void *user_data)
{
	scan_dev_info_t *deviceInfo = (scan_dev_info_t *)user_data;
	char             dev[BT_ADDR_LE_STR_LEN];
	int              i;
	int              error = -1;

	struct bt_conn *conn;

	switch (data->type) {
	case BT_DATA_UUID128_SOME:
	case BT_DATA_UUID128_ALL:
		if (data->data_len % (sizeof(struct bt_uuid_128) - sizeof(struct bt_uuid)) != 0) {
			printf("AD malformed\n");
			return true;
		}

		for (i = 0; i < data->data_len; i += (sizeof(struct bt_uuid_128) - sizeof(struct bt_uuid))) {
			struct bt_uuid_128 uuid;

			uuid.uuid.type = BT_UUID_TYPE_128;
			memcpy(&uuid.val[0], &data->data[i], sizeof(struct bt_uuid_128) - sizeof(struct bt_uuid));
			if (bt_uuid_cmp((struct bt_uuid *)&uuid, WIRELESS_UART_SERVICE)) {
				continue;
			}

			bt_addr_le_to_str(deviceInfo->addr, dev, sizeof(dev));
			printf("[DEVICE]: %s, AD evt type %u, AD data len %u, RSSI %i\n", dev, deviceInfo->ad_type,
				   deviceInfo->ad_len, deviceInfo->rssi);

			error = bt_le_scan_stop();
			if (error) {
				printf("Stop scan false.\n");
			}

			struct bt_conn_le_create_param param =
				BT_CONN_LE_CREATE_PARAM_INIT(BT_CONN_LE_OPT_NONE, BT_GAP_SCAN_FAST_INTERVAL, BT_GAP_SCAN_FAST_INTERVAL);
			error = bt_conn_le_create(deviceInfo->addr, &param, BT_LE_CONN_PARAM_DEFAULT, &conn);
			if (error) {
				printf("Failed to create connection (err %d)\n", error);
			} else {
				printf("Connection pending");
				/* unref connection obj in advance as app user */
				bt_conn_unref(conn);
			}
		}
	}

	return true;
}

static void wu_central_scan_callback(const bt_addr_le_t *addr, int8_t rssi, uint8_t type, struct net_buf_simple *ad)
{
	scan_dev_info_t deviceInfo;

	deviceInfo.addr    = addr;
	deviceInfo.ad_type = type;
	deviceInfo.ad_len  = ad->len;
	deviceInfo.rssi    = rssi;

#if 0
	char dev[BT_ADDR_LE_STR_LEN];

	bt_addr_le_to_str(addr, dev, sizeof(dev));
	PRINTF("[DEVICE]: %s, AD evt type %u, AD data len %u, RSSI %i\n", deviceInfo.dev, deviceInfo.ad_type, deviceInfo.ad_len, deviceInfo.rssi);
#endif

	if (type == BT_HCI_ADV_IND || type == BT_HCI_ADV_DIRECT_IND) {
		bt_data_parse(ad, wu_central_parse_callback, (void *)&deviceInfo);
	}
}
#endif

static void bt_ready(int error)
{
	bt_gatt_wu_config_t wuConfig;

	if (error) {
		printf("Bluetooth init failed (error %d)\n", error);
		return;
	}

	printf("Bluetooth initialized\n");

	wuConfig.data_received = wireless_uart_data_received;
	wuConfig.read          = wireless_uart_read;

	bt_gatt_wu_init("Wireless Uart Demo", "WU1234567890", &wuConfig);

	bt_conn_cb_register(&conn_callbacks);

#if CONFIG_BT_SMP
	bt_conn_auth_cb_register(&auth_cb_display);
#endif

#ifdef CONFIG_WU_CLIENT
	error = bt_le_scan_start(BT_LE_SCAN_ACTIVE, wu_central_scan_callback);
	if (error) {
		printf("Scan failed to start (error %d)\n", error);
		return;
	}
	printf("Scan successfully started\n");
#else
	error = bt_le_adv_start(BT_LE_ADV_CONN_FAST_2, ad, ARRAY_SIZE(ad), sd, ARRAY_SIZE(sd));
	if (error) {
		printf("Advertising failed to start (error %d)\n", error);
		return;
	}
	printf("Advertising successfully started\n");
#endif
}

/*
 *  Application entry point.
 */
void wireless_uart_start(void)
{
	int err;

	printf("BLE Wireless Uart demo start...\n");

	err = bt_enable(bt_ready);
	if (err) {
		printf("Bluetooth init failed (err %d)\n", err);
	}

	while (1) {
		k_sleep(K_MSEC(2000));

		/* Wireless Uart notification thread */
		bt_gatt_wu_notify();
	}
}
```

## src/wireless_uart.h
```c
/*
 * Copyright 2019~2024 NXP
 * All rights reserved.
 *
 * SPDX-License-Identifier: BSD-3-Clause
 */

#ifndef __WIRELESS_UART__H__
#define __WIRELESS_UART__H__

#ifdef __cplusplus
extern "C" {
#endif

/* -------------------------------------------------------------------------- */
/*                             Function prototypes                            */
/* -------------------------------------------------------------------------- */

void wireless_uart_start(void);

#ifdef __cplusplus
}
#endif

#endif /* __WIRELESS_UART__H__ */
```

## src/wu.c
```c
/*
 * Copyright 2019~2024 NXP
 * All rights reserved.
 *
 * SPDX-License-Identifier: BSD-3-Clause
 *
 * @file
 * @brief Wireless Uart Service Profile
 *
 */

/* -------------------------------------------------------------------------- */
/*                              Includes                                      */
/* -------------------------------------------------------------------------- */

#include <zephyr/bluetooth/gatt.h>
#include "wu.h"


/* -------------------------------------------------------------------------- */
/*                              Variable                                      */
/* -------------------------------------------------------------------------- */

static bt_gatt_wu_state_t s_wu_state;

/* -------------------------------------------------------------------------- */
/*                              Functions                                     */
/* -------------------------------------------------------------------------- */

void bt_gatt_wu_init(char *name, char *serial_no, bt_gatt_wu_config_t *config)
{
	s_wu_state.config              = *config;
	s_wu_state.name                = name;
	s_wu_state.serial_no           = serial_no;
	s_wu_state.read_stream_ccc_cfg = 0;
}

#ifdef CONFIG_WU_CLIENT
static void bt_gatt_wu_write_func(struct bt_conn *conn, uint8_t err, struct bt_gatt_write_params *params)
{
	/* Write response, do nothing */
}

static int bt_gatt_wu_read_response_for_write(void *param, uint8_t *buffer, ssize_t length)
{
	bt_gatt_wu_peer_state_t *state = (bt_gatt_wu_peer_state_t *)param;
	int                      ret   = -1;
	uint16_t                 mtu   = bt_gatt_get_mtu(state->conn);
	uint16_t                 len   = 0;
	int                      sent  = 0;

	while (length > 0U) {
		len    = length > (mtu - 3) ? mtu - 3 : length;
		length = length - len;
		if (state->discoverPermission & BT_GATT_CHRC_WRITE_WITHOUT_RESP) {
			ret = bt_gatt_write_without_response(state->conn, state->discoverWriteHandle, &buffer[sent], len, 0);
			if (ret >= 0) {
				sent += (int)len;
			} else {
				break;
			}
		} else if (state->discoverPermission & BT_GATT_CHRC_WRITE) {
			state->writeParams.data   = (const void *)&buffer[sent];
			state->writeParams.length = len;
			state->writeParams.handle = state->discoverWriteHandle;
			state->writeParams.offset = 0;
			state->writeParams.func   = bt_gatt_wu_write_func;
			ret                       = bt_gatt_write(state->conn, &state->writeParams);
			if (ret >= 0) {
				sent += (int)len;
			} else {
				break;
			}
		} else {
			break;
		}
	}

	return sent;
}

static uint8_t bt_gatt_wu_discovery_service(struct bt_conn                 *conn,
											const struct bt_gatt_attr      *attr,
											struct bt_gatt_discover_params *params)
{
	int err;

	if (!attr) {
		printf("Discover complete\n");
		memset(params, 0, sizeof(*params));
		return BT_GATT_ITER_STOP;
	}

	printf("[ATTRIBUTE] handle %u\n", attr->handle);

	if (!bt_uuid_cmp(s_wu_state.peer.discoverParams.uuid, WIRELESS_UART_SERVICE)) {
		memcpy(&s_wu_state.peer.serivceDiscoveryUuid, WIRELESS_UART_WRITE_STREAM,
			   sizeof(s_wu_state.peer.serivceDiscoveryUuid));
		s_wu_state.peer.discoverParams.uuid         = &s_wu_state.peer.serivceDiscoveryUuid.uuid;
		s_wu_state.peer.discoverParams.start_handle = attr->handle + 1;
		s_wu_state.peer.discoverParams.type         = BT_GATT_DISCOVER_CHARACTERISTIC;
#if defined(CONFIG_BT_GATT_CLIENT)
		err = bt_gatt_discover(conn, &s_wu_state.peer.discoverParams);
		if (err) {
			printf("Discover stream write service failed (err %d)\n", err);
		}
#endif
	} else if (!bt_uuid_cmp(s_wu_state.peer.discoverParams.uuid, WIRELESS_UART_WRITE_STREAM)) {
		struct bt_gatt_chrc *gattChrc = (struct bt_gatt_chrc *)attr->user_data;

		s_wu_state.peer.discoverPermission  = gattChrc->properties;
		s_wu_state.peer.discoverWriteHandle = attr->handle + 1;
	} else {
		/* Do Nothing */
	}

	return BT_GATT_ITER_STOP;
}

static void bt_gatt_wu_start_service_discovery(struct bt_conn *conn)
{
	int     err;

	memcpy(&s_wu_state.peer.serivceDiscoveryUuid, WIRELESS_UART_SERVICE, sizeof(s_wu_state.peer.serivceDiscoveryUuid));
	s_wu_state.peer.discoverParams.uuid         = &s_wu_state.peer.serivceDiscoveryUuid.uuid;
	s_wu_state.peer.discoverParams.func         = bt_gatt_wu_discovery_service;
	s_wu_state.peer.discoverParams.start_handle = 0x0001;
	s_wu_state.peer.discoverParams.end_handle   = 0xffff;
	s_wu_state.peer.discoverParams.type         = BT_GATT_DISCOVER_PRIMARY;

#if defined(CONFIG_BT_GATT_CLIENT)
	err = bt_gatt_discover(conn, &s_wu_state.peer.discoverParams);
	if (err) {
		printf("Discover failed(err %d)\n", err);
		return;
	}
#endif
}
#endif

static void bt_gatt_wu_get_mtu_callback(struct bt_conn *conn, uint8_t err, struct bt_gatt_exchange_params *params)
{
	if (err) {
		printf("GATT MTU exchange response failed (err %u)\n", err);
	} else {
		printf("GATT MTU exchanged: %d\n", bt_gatt_get_mtu(conn));
	}

#ifdef CONFIG_WU_CLIENT
	bt_gatt_wu_start_service_discovery(conn);
#endif
}

void bt_gatt_wu_connected(struct bt_conn *conn)
{
	int err;

	s_wu_state.peer.conn                = conn;
	s_wu_state.peer.exchangeParams.func = bt_gatt_wu_get_mtu_callback;
	err                                 = bt_gatt_exchange_mtu(conn, &s_wu_state.peer.exchangeParams);
	if (err) {
		printf("Exchange GATT mtu failed (err %d)\n", err);
	}
}

void bt_gatt_wu_disconnected(struct bt_conn *conn)
{
	s_wu_state.peer.discoverWriteHandle = 0;
	s_wu_state.peer.discoverPermission  = 0;
	s_wu_state.peer.conn                = NULL;
	s_wu_state.read_stream_ccc_cfg      = 0;
}

static int bt_gatt_wu_read_response_for_read(void *param, uint8_t *buffer, ssize_t length)
{
	bt_gatt_wu_read *read = (bt_gatt_wu_read *)param;
	int                     ret  = -1;
	uint16_t                mtu  = bt_gatt_get_mtu(read->state->conn);
	uint16_t                len  = 0;
	int                     sent = 0;

	while (length > 0) {
		len    = length > (mtu - 3) ? mtu - 3 : length;
		length = length - len;

		ret = bt_gatt_attr_read(read->state->conn, read->attr, read->buf, read->len, read->offset, &buffer[sent], len);
		if (ret >= 0) {
			sent += len;
		} else {
			break;
		}
	}

	return sent;
}

static ssize_t bt_gatt_wu_read_stream(struct bt_conn            *conn,
									  const struct bt_gatt_attr *attr,
									  void                      *buf,
									  uint16_t                   len,
									  uint16_t                   offset)
{
	bt_gatt_wu_read read;
	ssize_t         length = 0;

	read.attr   = attr;
	read.buf    = buf;
	read.len    = len;
	read.offset = offset;
	read.state  = &s_wu_state.peer;

	length = s_wu_state.config.read(s_wu_state.peer.conn, bt_gatt_wu_read_response_for_read, &read);

	return length;
}

static void bt_gatt_wu_read_stream_ccc_cfg_changed(const struct bt_gatt_attr *attr, uint16_t value)
{
	s_wu_state.read_stream_ccc_cfg = (value & BT_GATT_CCC_NOTIFY);
}

static ssize_t bt_gatt_wu_write_stream(struct bt_conn            *conn,
									   const struct bt_gatt_attr *attr,
									   const void                *buf,
									   uint16_t                   len,
									   uint16_t                   offset,
									   uint8_t                    flags)
{
#if 0
	printf("Data received (%d) 0x: ", len);
	for (int i = 0; i < len; i++) {
		printf("%02X ", ((uint8_t *)buf)[i]);
	}
	printf("\r\n");
#endif
	s_wu_state.config.data_received(conn, (uint8_t *)buf, len);

	return 0;
}

static ssize_t bt_gatt_wu_info(struct bt_conn            *conn,
							   const struct bt_gatt_attr *attr,
							   void                      *buf,
							   uint16_t                   len,
							   uint16_t                   offset)
{
	return bt_gatt_attr_read(conn, attr, buf, len, offset, s_wu_state.name, strlen(s_wu_state.name));
}

static ssize_t bt_gatt_wu_serial_no(struct bt_conn            *conn,
									const struct bt_gatt_attr *attr,
									void                      *buf,
									uint16_t                   len,
									uint16_t                   offset)
{
	return bt_gatt_attr_read(conn, attr, buf, len, offset, s_wu_state.serial_no, strlen(s_wu_state.serial_no));
}

/* Wireless Uart Service Declaration */
BT_GATT_SERVICE_DEFINE(
	wirelessUart,
	BT_GATT_PRIMARY_SERVICE(WIRELESS_UART_SERVICE),

	BT_GATT_CHARACTERISTIC(WIRELESS_UART_WRITE_STREAM,
						   BT_GATT_CHRC_WRITE_WITHOUT_RESP,
						   BT_GATT_PERM_WRITE,
						   NULL,
						   bt_gatt_wu_write_stream,
						   NULL),

	BT_GATT_CHARACTERISTIC(WIRELESS_UART_RAED_STREAM,
						   BT_GATT_CHRC_READ | BT_GATT_CHRC_NOTIFY,
						   BT_GATT_PERM_READ,
						   bt_gatt_wu_read_stream,
						   NULL,
						   NULL),
	BT_GATT_CCC(bt_gatt_wu_read_stream_ccc_cfg_changed, BT_GATT_PERM_READ | BT_GATT_PERM_WRITE),

	BT_GATT_CHARACTERISTIC(WIRELESS_UART_INFO, BT_GATT_CHRC_READ, BT_GATT_PERM_READ, bt_gatt_wu_info, NULL, NULL),

	BT_GATT_CHARACTERISTIC(WIRELESS_UART_SERIAL_NO,
						   BT_GATT_CHRC_READ,
						   BT_GATT_PERM_READ,
						   bt_gatt_wu_serial_no,
						   NULL,
						   NULL),
);

static int bt_gatt_wu_read_response_for_notify(void *param, uint8_t *buffer, ssize_t length)
{
	bt_gatt_wu_peer_state_t *state = (bt_gatt_wu_peer_state_t *)param;
	int                      ret   = -1;
	uint16_t                 mtu   = bt_gatt_get_mtu(state->conn);
	uint16_t                 len   = 0;
	int                      sent  = 0;

	while (length > 0U) {
		len    = length > (mtu - 3) ? mtu - 3 : length;
		length = length - len;
		ret    = bt_gatt_notify(state->conn, &wirelessUart.attrs[3], &buffer[sent], len);
		if (ret >= 0) {
			sent += (int)len;
		} else {
			break;
		}
	}
	return sent;
}

static void bt_gatt_wu_notify_internal(void)
{
	int ret;

	if (s_wu_state.read_stream_ccc_cfg) {
		ret = s_wu_state.config.read(s_wu_state.peer.conn, bt_gatt_wu_read_response_for_notify, &s_wu_state.peer);
	}
#ifdef CONFIG_WU_CLIENT
	else if (s_wu_state.peer.discoverWriteHandle) {
		ret = s_wu_state.config.read(s_wu_state.peer.conn, bt_gatt_wu_read_response_for_write, &s_wu_state.peer);
	}
#endif

	(void)ret;
}

void bt_gatt_wu_notify(void)
{
	bt_gatt_wu_notify_internal();
}
```

## src/wu.h
```c
/*
 * Copyright 2019~2024 NXP
 * All rights reserved.
 *
 * SPDX-License-Identifier: BSD-3-Clause
 *
 * @file
 * @brief Wireless Uart Service Profile
 *
 */

#ifndef __WU_H__
#define __WU_H__

#ifdef __cplusplus
extern "C" {
#endif

/* -------------------------------------------------------------------------- */
/*                               Define                                       */
/* -------------------------------------------------------------------------- */

#define WIRELESS_UART_SERVICE_UUID \
	0xE0, 0x1C, 0x4B, 0x5E, 0x1E, 0xEB, 0xA1, 0x5C, 0xEE, 0xF4, 0x5E, 0xBA, 0x00, 0x01, 0xFF, 0x01
#define WIRELESS_UART_SERVICE BT_UUID_DECLARE_128(WIRELESS_UART_SERVICE_UUID)

#define WIRELESS_UART_RAED_STREAM \
	BT_UUID_DECLARE_128(0xE0, 0x1C, 0x4B, 0x5E, 0x1E, 0xEB, 0xA1, 0x5C, 0xEE, 0xF4, 0x5E, 0xBA, 0x02, 0x01, 0xFF, 0x01)
#define WIRELESS_UART_WRITE_STREAM \
	BT_UUID_DECLARE_128(0xE0, 0x1C, 0x4B, 0x5E, 0x1E, 0xEB, 0xA1, 0x5C, 0xEE, 0xF4, 0x5E, 0xBA, 0x01, 0x01, 0xFF, 0x01)
#define WIRELESS_UART_INFO \
	BT_UUID_DECLARE_128(0xE0, 0x1C, 0x4B, 0x5E, 0x1E, 0xEB, 0xA1, 0x5C, 0xEE, 0xF4, 0x5E, 0xBA, 0x03, 0x01, 0xFF, 0x01)
#define WIRELESS_UART_SERIAL_NO \
	BT_UUID_DECLARE_128(0xE0, 0x1C, 0x4B, 0x5E, 0x1E, 0xEB, 0xA1, 0x5C, 0xEE, 0xF4, 0x5E, 0xBA, 0x04, 0x01, 0xFF, 0x01)

typedef int (*bt_gatt_wu_read_response_t)(void *param, uint8_t *buffer, ssize_t length);
typedef int (*bt_gatt_wu_read_request_t)(struct bt_conn *conn, bt_gatt_wu_read_response_t response, void *param);
typedef int (*bt_gatt_wu_data_received_t)(struct bt_conn *conn, uint8_t *buffer, ssize_t length);

/* -------------------------------------------------------------------------- */
/*                               Structure                                    */
/* -------------------------------------------------------------------------- */

typedef struct _bt_gatt_wu_config {
	bt_gatt_wu_read_request_t  read;
	bt_gatt_wu_data_received_t data_received;
} bt_gatt_wu_config_t;

typedef struct _bt_gatt_wu_peer_state {
	struct bt_conn                *conn;
	struct bt_uuid_128             serivceDiscoveryUuid;
	struct bt_gatt_exchange_params exchangeParams;
	struct bt_gatt_discover_params discoverParams;
	struct bt_gatt_write_params    writeParams;
	volatile uint8_t               discoverWriteHandle;
	volatile uint8_t               discoverPermission;
} bt_gatt_wu_peer_state_t;

typedef struct _bt_gatt_wu_state {
	char                   *name;
	char                   *serial_no;
	bt_gatt_wu_config_t     config;
	bt_gatt_wu_peer_state_t peer;
	volatile uint8_t        read_stream_ccc_cfg;
} bt_gatt_wu_state_t;

typedef struct _bt_gatt_wu_read {
	bt_gatt_wu_peer_state_t   *state;
	const struct bt_gatt_attr *attr;
	void                      *buf;
	uint16_t                   len;
	uint16_t                   offset;
} bt_gatt_wu_read;

/* -------------------------------------------------------------------------- */
/*                             Function prototypes                            */
/* -------------------------------------------------------------------------- */

void bt_gatt_wu_init(char *name, char *serial_no, bt_gatt_wu_config_t *config);
void bt_gatt_wu_connected(struct bt_conn *conn);
void bt_gatt_wu_disconnected(struct bt_conn *conn);
void bt_gatt_wu_notify(void);

#ifdef __cplusplus
}
#endif

#endif /* __WU_H__ */
```
