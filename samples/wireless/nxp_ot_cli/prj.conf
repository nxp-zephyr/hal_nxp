## CMakeLists.txt
```
# Copyright 2024 NXP
# SPDX - License - Identifier : Apache - 2.0

cmake_minimum_required(VERSION 3.20.0)

find_package(Zephyr REQUIRED HINTS $ENV{ZEPHYR_BASE})
project(nxp_ot_cli)

FILE(GLOB app_sources src/*.c)
target_sources(app PRIVATE ${app_sources})
```

## Kconfig
```
# Copyright 2024 NXP
# SPDX-License-Identifier: Apache-2.0

config SUPPORT_BLE_15D4
	int "Support IEEE 802154"
	default 1

config SUPPORT_BLE
	int "Support bluetooth low energy"
	default 0

config SUPPORT_WIFI
	int "Support WiFi"
	default 0

source "Kconfig.zephyr"
module = OT_COMMAND_LINE_INTERFACE
module-str = ot_cli
source "${ZEPHYR_BASE}/subsys/logging/Kconfig.template.log_config"
```

## sample.yaml
```
sample:
  name: OpenThread CLI sample
  description: Test OpenThread Command Line Interface.
tests:
  sample.boards.rd_rw612_bga.nxp_ot_cli:
    build_only: true
    platform_allow:
      - rd_rw612_bga
      - frdm_rw612
    integration_platforms:
      - rd_rw612_bga
```

## prj.conf
```kconfig
#
# Copyright 2024, NXP
#

# Boot
CONFIG_BOOT_BANNER=n

# os
CONFIG_EVENTS=y
CONFIG_SYS_HEAP_AUTO=y
CONFIG_HEAP_MEM_POOL_SIZE=8192
CONFIG_MAIN_STACK_SIZE=8192
CONFIG_INIT_STACKS=y

# thread
CONFIG_THREAD_NAME=y
CONFIG_THREAD_MONITOR=y
CONFIG_MAIN_THREAD_PRIORITY=5
CONFIG_DEBUG_THREAD_INFO=y

# Use NVS as settings backend
CONFIG_NVS=y
CONFIG_NVS_LOOKUP_CACHE=y
CONFIG_NVS_LOOKUP_CACHE_SIZE=4096

# C library
CONFIG_NEWLIB_LIBC=y

# CPP library
CONFIG_CPP=y

# IMU & FW loader
CONFIG_NXP_RF_IMU=y
CONFIG_NXP_FW_LOADER=y

# Network shell
CONFIG_SHELL=y
CONFIG_OPENTHREAD_SHELL=y
CONFIG_SHELL_ARGC_MAX=26
CONFIG_SHELL_CMD_BUFF_SIZE=416
CONFIG_SHELL_STACK_SIZE=5120
CONFIG_SHELL_DEFAULT_TERMINAL_WIDTH=1024

# Generic networking options
CONFIG_NETWORKING=y
CONFIG_NET_L2_OPENTHREAD=y
CONFIG_NET_PKT_TXTIME=y

# Enable Openthread host rcp
CONFIG_HDLC_RCP_IF=y
CONFIG_OPENTHREAD_MANUAL_START=y

# Enable OpenThread features set
CONFIG_OPENTHREAD_THREAD_VERSION_1_3=y
CONFIG_OPENTHREAD_DHCP6_SERVER=y
CONFIG_OPENTHREAD_COMMISSIONER=y
CONFIG_OPENTHREAD_BORDER_AGENT=y
CONFIG_OPENTHREAD_BORDER_ROUTER=y
CONFIG_OPENTHREAD_UDP_FORWARD=y
CONFIG_OPENTHREAD_ENABLE_SERVICE=y
CONFIG_OPENTHREAD_EXTERNAL_HEAP=y
CONFIG_OPENTHREAD_PING_SENDER=y
CONFIG_OPENTHREAD_SLAAC=y
CONFIG_OPENTHREAD_SETTINGS_RAM=y
CONFIG_OPENTHREAD_NUM_MESSAGE_BUFFERS=256
CONFIG_OPENTHREAD_COAP=y
CONFIG_OPENTHREAD_JOINER=y
CONFIG_OPENTHREAD_REFERENCE_DEVICE=y
CONFIG_OPENTHREAD_DHCP6_CLIENT=y
CONFIG_OPENTHREAD_LINK_METRICS_INITIATOR=y
CONFIG_OPENTHREAD_LINK_METRICS_SUBJECT=y
CONFIG_OPENTHREAD_DUA=y
CONFIG_OPENTHREAD_MLR=y
CONFIG_OPENTHREAD_ECDSA=y
CONFIG_OPENTHREAD_DNS_CLIENT=y
CONFIG_OPENTHREAD_DNSSD_SERVER=y
CONFIG_OPENTHREAD_SRP_CLIENT=y
CONFIG_OPENTHREAD_SRP_SERVER=y
CONFIG_OPENTHREAD_MAC_FILTER=y
CONFIG_OPENTHREAD_IP6_FRAGM=y
CONFIG_NET_CONFIG_SETTINGS=y

# log & debug
CONFIG_SPEED_OPTIMIZATIONS=y
```

## src/main.c
```c
/**
 *  Copyright 2024, NXP
 *
 *  SPDX-License-Identifier: Apache-2.0
 *
 *  @file  main.c
 *  @brief main file
 */

#include <zephyr/logging/log.h>

LOG_MODULE_REGISTER(nxp_ot_cli, CONFIG_OT_COMMAND_LINE_INTERFACE_LOG_LEVEL);

int main(void)
{
	LOG_INF("nxp_ot_cli entry");

	return 0;
}
```
