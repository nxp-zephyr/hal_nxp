## CMakeLists.txt
```
# Copyright 2023-2024 NXP
#
# SPDX-License-Identifier: Apache-2.0

cmake_minimum_required(VERSION 3.20.0)

find_package(Zephyr REQUIRED HINTS $ENV{ZEPHYR_BASE})
project(nxp_els_pkc)

target_include_directories(app
    PUBLIC
        ${APPLICATION_SOURCE_DIR}/src
)

FILE(GLOB app_sources src/*.c)
target_sources(app PRIVATE ${app_sources})
```

## Kconfig
```
# Copyright 2023-2024 NXP
#
# SPDX-License-Identifier: Apache-2.0

config MCUX_ELS_PKC_EXAMPLES
	bool "Support of MCUX ELS PKC examples"
	help
	    Builds with els_pkc examples to verify high level els_pkc api calls.

	    The option includes the example src files from els_pkc component.

source "Kconfig.zephyr"
```

## sample.yaml
```
# Copyright 2023-2024 NXP
#
# SPDX-License-Identifier: Apache-2.0

sample:
  name: nxp els pkc
common:
  tags:
    - crypto
    - els_pkc
tests:
  sample.crypto.nxp_els_pkc:
    platform_allow:
      - rd_rw612_bga
      - frdm_rw612
    integration_platforms:
      - rd_rw612_bga
    harness: console
    harness_config:
      type: one_line
      regex:
        - "RESULT: All 24 test PASS!!"
```

## prj.conf
```kconfig
# Config stack size
CONFIG_MAIN_STACK_SIZE=4096

# Include psa_crypto_driver_els_pkc in build
CONFIG_MCUX_ELS_PKC=y
CONFIG_MCUX_ELS_PKC_EXAMPLES=y
```

## src/main.c
```c
/**
 *  Copyright 2023-2024 NXP
 *
 *  SPDX-License-Identifier: Apache-2.0
 *
 *  @file  main.c
 *  @brief main file
 */

#include <stdio.h>

#include "fsl_common.h"
#include "fsl_device_registers.h"
#include "els_pkc_examples.h"

#include <mcux_els.h>
#include <mcux_pkc.h>

/*************************************************************************
 * Definitions
 ************************************************************************/

/*************************************************************************
 * Prototypes
 ************************************************************************/

/*************************************************************************
 * Code
 ************************************************************************/

/************************************************************************
 * CRYPTO_InitHardware
 ***********************************************************************/
/*!
 * @brief Main function
 */
int main(void)
{
	uint8_t pass = 0;
	uint8_t fail = 0;

	printf("\n================\n");
	printf("ELS hash example\n");
	printf("================\n");

	printf("SHA224 one shot:");
	if (mcuxClHashModes_sha224_oneshot_example() == true) {
		pass++;
		printf("pass\n");
	} else {
		fail++;
		printf("fail\n");
	}

	printf("SHA256 one shot:");
	if (mcuxClHashModes_sha256_oneshot_example() == true) {
		pass++;
		printf("pass\n");
	} else {
		fail++;
		printf("fail\n");
	}

	printf("SHA256 streaming example:");
	if (mcuxClHashModes_sha256_streaming_example() == true) {
		pass++;
		printf("pass\n");
	} else {
		fail++;
		printf("fail\n");
	}

	printf("SHA256 long message example:");
	if (mcuxClHashModes_sha256_longMsgOneshot_example() == true) {
		pass++;
		printf("pass\n");
	} else {
		fail++;
		printf("fail\n");
	}

	printf("SHA384 one shot:");
	if (mcuxClHashModes_sha384_oneshot_example() == true) {
		pass++;
		printf("pass\n");
	} else {
		fail++;
		printf("fail\n");
	}

	printf("SHA512 one shot:");
	if (mcuxClHashModes_sha512_oneshot_example() == true) {
		pass++;
		printf("pass\n");
	} else {
		fail++;
		printf("fail\n");
	}

	printf("\n=================================\n");
	printf("ELS PKC asymmetric cipher example\n");
	printf("=================================\n");

	printf("PKC ECC keygen sign verify:");
	if (mcuxClEls_Ecc_Keygen_Sign_Verify_example() == true) {
		pass++;
		printf("pass\n");
	} else {
		fail++;
		printf("fail\n");
	}

	printf("PKC RSA no-verify:");
	if (mcuxClRsa_verify_NoVerify_example() == true) {
		pass++;
		printf("pass\n");
	} else {
		fail++;
		printf("fail\n");
	}

	printf("PKC RSA sign no-encode:");
	if (mcuxClRsa_sign_NoEncode_example() == true) {
		pass++;
		printf("pass\n");
	} else {
		fail++;
		printf("fail\n");
	}

	printf("PKC RSA-PSS sign SHA256:");
	if (mcuxClRsa_sign_pss_sha2_256_example() == true) {
		pass++;
		printf("pass\n");
	} else {
		fail++;
		printf("fail\n");
	}

	printf("PKC RSA-PSS verify SHA256:");
	if (mcuxClRsa_verify_pssverify_sha2_256_example() == true) {
		pass++;
		printf("pass\n");
	} else {
		fail++;
		printf("fail\n");
	}

	printf("PKC ECC Curve25519:");
	if (mcuxClEcc_MontDH_Curve25519_example() == true) {
		pass++;
		printf("pass\n");
	} else {
		fail++;
		printf("fail\n");
	}

	printf("TLS Master session keys:");
	if (mcuxClEls_Tls_Master_Key_Session_Keys_example() == true) {
		pass++;
		printf("pass\n");
	} else {
		fail++;
		printf("fail\n");
	}

	printf("\n======================\n");
	printf("ELS PKC common example\n");
	printf("======================\n");

	printf("ELS get info:");
	if (mcuxClEls_Common_Get_Info_example() == true) {
		pass++;
		printf("pass\n");
	} else {
		fail++;
		printf("fail\n");
	}

	printf("RNG PRNG random:");
	if (mcuxClEls_Rng_Prng_Get_Random_example() == true) {
		pass++;
		printf("pass\n");
	} else {
		fail++;
		printf("fail\n");
	}

	printf("Flow protection:");
	if (mcuxCsslFlowProtection_example() == true) {
		pass++;
		printf("pass\n");
	} else {
		fail++;
		printf("fail\n");
	}

	printf("Memory compare:");
	if (mcuxCsslMemory_Compare_example() == EXIT_CODE_OK) {
		pass++;
		printf("pass\n");
	} else {
		fail++;
		printf("fail\n");
	}

	printf("Memory copy:");
	if (mcuxCsslMemory_Copy_example() == EXIT_CODE_OK) {
		pass++;
		printf("pass\n");
	} else {
		fail++;
		printf("fail\n");
	}

	printf("Key component operations:");
	if (mcuxClKey_example() == true) {
		pass++;
		printf("pass\n");
	} else {
		fail++;
		printf("fail\n");
	}

	printf("ELS power down wake-up init:");
	if (ELS_PowerDownWakeupInit(ELS) == kStatus_Success) {
		pass++;
		printf("pass\n");
	} else {
		fail++;
		printf("fail\n");
	}

	printf("PKC power down wake-up init:");
	if (PKC_PowerDownWakeupInit(PKC) == kStatus_Success) {
		pass++;
		printf("pass\n");
	} else {
		fail++;
		printf("fail\n");
	}

	printf("\n============================\n");
	printf("ELS symmetric cipher example\n");
	printf("============================\n");

	printf("AES128-CBC encryption:");
	if (mcuxClEls_Cipher_Aes128_Cbc_Encrypt_example() == true) {
		pass++;
		printf("pass\n");
	} else {
		fail++;
		printf("fail\n");
	}

	printf("AES128-ECB encryption:");
	if (mcuxClEls_Cipher_Aes128_Ecb_Encrypt_example() == true) {
		pass++;
		printf("pass\n");
	} else {
		fail++;
		printf("fail\n");
	}

	printf("CMAC AES128:");
	if (mcuxClMacModes_Els_Cmac_Aes128_Oneshot_example() == true) {
		pass++;
		printf("pass\n");
	} else {
		fail++;
		printf("fail\n");
	}

	printf("\nRESULT: ");
	if (fail == 0) {
		printf("All %d test PASS!!\n", pass);
	} else {
		printf("%d / %d test PASSED, %d FAILED\n", pass, pass + fail,
		       fail);
	}

	printf("ELS-PKC stand-alone examples end\n");
	return 0;
}
```

## src/els_pkc_examples.h
```c
/**
 * Copyright 2023-2024 NXP
 *
 * SPDX-License-Identifier: Apache-2.0
 */

#ifndef _ELS_PKC_EXAMPLES_H_
#define _ELS_PKC_EXAMPLES_H_

/*******************************************************************************
 * Definitions
 ******************************************************************************/
#define EXIT_CODE_ERROR 0x00U
#define EXIT_CODE_OK    0x01U
/*******************************************************************************
 * API
 ******************************************************************************/

extern bool mcuxClHashModes_sha224_oneshot_example(void);
extern bool mcuxClHashModes_sha256_oneshot_example(void);
extern bool mcuxClHashModes_sha256_longMsgOneshot_example(void);
extern bool mcuxClHashModes_sha256_streaming_example(void);
extern bool mcuxClHashModes_sha384_oneshot_example(void);
extern bool mcuxClHashModes_sha512_oneshot_example(void);

extern bool mcuxClEls_Ecc_Keygen_Sign_Verify_example(void);
extern bool mcuxClRsa_sign_NoEncode_example(void);
extern bool mcuxClRsa_sign_pss_sha2_256_example(void);
extern bool mcuxClRsa_verify_NoVerify_example(void);
extern bool mcuxClRsa_verify_pssverify_sha2_256_example(void);
extern bool mcuxClEcc_MontDH_Curve25519_example(void);
extern bool mcuxClEls_Tls_Master_Key_Session_Keys_example(void);

extern bool mcuxClEls_Rng_Prng_Get_Random_example(void);
extern bool mcuxClEls_Common_Get_Info_example(void);
extern bool mcuxCsslFlowProtection_example(void);
extern uint32_t mcuxCsslMemory_Compare_example(void);
extern uint32_t mcuxCsslMemory_Copy_example(void);
extern bool mcuxClKey_example(void);

extern bool mcuxClEls_Cipher_Aes128_Cbc_Encrypt_example(void);
extern bool mcuxClEls_Cipher_Aes128_Ecb_Encrypt_example(void);
extern bool mcuxClMacModes_Els_Cmac_Aes128_Oneshot_example(void);

#endif /* _ELS_PKC_EXAMPLES_H_ */
```
