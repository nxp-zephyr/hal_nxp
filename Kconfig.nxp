## Kconfig.nxp
```kconfig
# Copyright 2024 NXP

# SPDX-License-Identifier: Apache-2.0
# Top level Kconfig file for out of tree ZSDK

source "$(ZEPHYR_ZSDK_MODULE_DIR)/drivers/Kconfig"
```

## boards/nxp/frdm_rw612/board.yml
```yaml
board:
  name: frdm_rw612
  vendor: nxp
  socs:
    - name: rw612
      variants:
        - name: ns
```

## drivers/Kconfig
```kconfig
# Out of tree drivers configuration options

# Copyright 2024 NXP
# SPDX-License-Identifier: Apache-2.0

menu "Device Drivers"


endmenu
```

## mcux/mcux-sdk-ng/components/codec/Kconfig
```kconfig
# Copyright 2024 NXP
# SPDX-License-Identifier: BSD-3-Clause

config MCUX_COMPONENT_component.codec_i2c
    bool
    select MCUX_COMPONENT_component.i2c_adapter_interface

config MCUX_COMPONENT_driver.codec
    bool

config MCUX_COMPONENT_component.codec_adapters
    bool

config MCUX_COMPONENT_component.wm8904_adapter
    bool

config MCUX_COMPONENT_component.wm8960_adapter
    bool

config MCUX_COMPONENT_component.wm8962_adapter
    bool

config MCUX_COMPONENT_component.wm8524_adapter
    bool

config MCUX_COMPONENT_component.sgtl_adapter
    bool

config MCUX_COMPONENT_component.da7212_adapter
    bool

config MCUX_COMPONENT_component.ak4497_adapter
    bool

config MCUX_COMPONENT_component.tfa9xxx_adapter
    bool

config MCUX_COMPONENT_component.tfa9896_adapter
    bool

config MCUX_COMPONENT_component.cs42888_adapter
    bool

config MCUX_COMPONENT_component.cs42448_adapter
    bool

config MCUX_COMPONENT_component.pcm186x_adapter
    bool

config MCUX_COMPONENT_component.pcm512x_adapter
    bool

config MCUX_COMPONENT_driver.ak4497
    bool "ak4497"
    select MCUX_COMPONENT_component.codec_i2c
    select MCUX_COMPONENT_driver.codec
    select MCUX_COMPONENT_component.ak4497_adapter
    select MCUX_COMPONENT_component.codec_adapters

config MCUX_COMPONENT_driver.cs42448
    bool "cs42448"
    select MCUX_COMPONENT_component.codec_i2c
    select MCUX_COMPONENT_driver.codec
    select MCUX_COMPONENT_component.cs42448_adapter
    select MCUX_COMPONENT_component.codec_adapters

config MCUX_COMPONENT_driver.cs42888
    bool "cs42888"
    select MCUX_COMPONENT_component.codec_i2c
    select MCUX_COMPONENT_driver.codec
    select MCUX_COMPONENT_component.cs42888_adapter
    select MCUX_COMPONENT_component.codec_adapters

config MCUX_COMPONENT_driver.dialog7212
    bool "da7212"
    select MCUX_COMPONENT_component.codec_i2c
    select MCUX_COMPONENT_driver.codec
    select MCUX_COMPONENT_component.da7212_adapter
    select MCUX_COMPONENT_component.codec_adapters

config MCUX_COMPONENT_driver.pcm186x
    bool "pcm186x"
    select MCUX_COMPONENT_component.codec_i2c
    select MCUX_COMPONENT_driver.codec
    select MCUX_COMPONENT_component.pcm186x_adapter
    select MCUX_COMPONENT_component.codec_adapters

config MCUX_COMPONENT_driver.pcm512x
    bool "pcm512x"
    select MCUX_COMPONENT_component.codec_i2c
    select MCUX_COMPONENT_driver.codec
    select MCUX_COMPONENT_component.pcm512x_adapter
    select MCUX_COMPONENT_component.codec_adapters

config MCUX_COMPONENT_driver.sgtl5000
    bool "sgtl5000"
    select MCUX_COMPONENT_component.codec_i2c
    select MCUX_COMPONENT_driver.codec
    select MCUX_COMPONENT_component.sgtl_adapter
    select MCUX_COMPONENT_component.codec_adapters

config MCUX_COMPONENT_driver.tfa9xxx
    bool "tfa9xxx"
    select MCUX_COMPONENT_component.codec_i2c
    select MCUX_COMPONENT_driver.codec
    select MCUX_COMPONENT_component.tfa9xxx_adapter
    select MCUX_COMPONENT_component.codec_adapters

config MCUX_COMPONENT_driver.tfa9xxx_hal
    bool "tfa9xxx_hal"
    select MCUX_COMPONENT_component.codec_i2c
    select MCUX_COMPONENT_driver.tfa9xxx
    select MCUX_COMPONENT_driver.codec
    select MCUX_COMPONENT_component.codec_adapters

config MCUX_COMPONENT_driver.tfa9896
    bool "tfa9896"
    select MCUX_COMPONENT_component.codec_i2c
    select MCUX_COMPONENT_driver.codec
    select MCUX_COMPONENT_component.tfa9896_adapter
    select MCUX_COMPONENT_component.codec_adapters

config MCUX_COMPONENT_driver.wm8524
    bool "wm8524"
    select MCUX_COMPONENT_component.codec_i2c
    select MCUX_COMPONENT_driver.codec
    select MCUX_COMPONENT_component.wm8524_adapter
    select MCUX_COMPONENT_component.codec_adapters

config MCUX_COMPONENT_driver.wm8904
    bool "wm8904"
    select MCUX_COMPONENT_component.codec_i2c
    select MCUX_COMPONENT_driver.codec
    select MCUX_COMPONENT_component.wm8904_adapter
    select MCUX_COMPONENT_component.codec_adapters

config MCUX_COMPONENT_driver.wm8960
    bool "wm8960"
    select MCUX_COMPONENT_component.codec_i2c
    select MCUX_COMPONENT_driver.codec
    select MCUX_COMPONENT_component.wm8960_adapter
    select MCUX_COMPONENT_component.codec_adapters

config MCUX_COMPONENT_driver.wm8962
    bool "wm8962"
    select MCUX_COMPONENT_component.codec_i2c
    select MCUX_COMPONENT_driver.codec
    select MCUX_COMPONENT_component.wm8962_adapter
    select MCUX_COMPONENT_component.codec_adapters
```

## mcux/mcux-sdk-ng/components/ele_crypto/Kconfig
```kconfig
# Copyright 2024 NXP
# SPDX-License-Identifier: BSD-3-Clause

menu "ELE Crypto"

  config MCUX_COMPONENT_component.ele_crypto
      bool "ele_crypto"
      select MCUX_COMPONENT_driver.s3mu

      if MCUX_COMPONENT_component.ele_crypto
        choice MCUX_DEPENDENCY_COMPONENT_component.ele_crypto.cache_driver
          prompt "ele_crypto cache dependency"
          default MCUX_DEPENDENCY_COMPONENT_component.ele_crypto_CM7_CACHE
          config MCUX_DEPENDENCY_COMPONENT_component.ele_crypto_CM7_CACHE
              bool "MCUX_DEPENDENCY_COMPONENT_component.ele_crypto_CM7_CACHE"
              select MCUX_COMPONENT_driver.memory
              select MCUX_COMPONENT_driver.cache_armv7_m7
              depends on MCUX_HW_CORE_CM7F

          config MCUX_DEPENDENCY_COMPONENT_component.ele_crypto_CM33_XCACHE
              bool "MCUX_DEPENDENCY_COMPONENT_component.ele_crypto_CM33_XCACHE"
              select MCUX_COMPONENT_driver.cache_xcache
              depends on MCUX_HW_CORE_CM33

        endchoice
      endif

  config MCUX_COMPONENT_component.ele_nvm_manager
      bool "ele_nvm_manager"
      select MCUX_COMPONENT_component.ele_crypto

endmenu
```

## mcux/mcux-sdk-ng/components/i2c/Kconfig
```kconfig
# Copyright 2024-2025 NXP
# SPDX-License-Identifier: BSD-3-Clause

menuconfig  MCUX_COMPONENT_component.i2c_adapter_interface
    bool "I2C"
    help
        Enable component i2c_adapter

if MCUX_COMPONENT_component.i2c_adapter_interface

    config MCUX_HAS_DEPENDENCY_component.lpi2c_adapter
        bool
        default y if MCUX_HAS_COMPONENT_driver.lpi2c || MCUX_HAS_COMPONENT_driver.lpflexcomm_lpi2c

    choice
        depends on MCUX_COMPONENT_component.i2c_adapter_interface
        prompt "I2C adapter implementation"

        config MCUX_COMPONENT_component.flexcomm_i2c_adapter
            bool "flexcomm_i2c"
            help
                Enable component.flexcomm_i2c_adapter component
            select MCUX_COMPONENT_driver.flexcomm_i2c
            depends on MCUX_HAS_COMPONENT_driver.flexcomm_i2c

        config MCUX_COMPONENT_component.i2c_adapter
            bool "i2c"
            help
                Enable component.i2c_adapter component
            select MCUX_COMPONENT_driver.i2c
            depends on MCUX_HAS_COMPONENT_driver.i2c

        config MCUX_COMPONENT_component.ii2c_adapter
            bool "ii2c"
            help
                Enable component.ii2c_adapter component
            select MCUX_COMPONENT_driver.ii2c
            depends on MCUX_HAS_COMPONENT_driver.ii2c

        config MCUX_COMPONENT_component.lpc_i2c_adapter
            bool "lpc_i2c"
            help
                Enable component.lpc_i2c_adapter component
            select MCUX_COMPONENT_driver.lpc_i2c
            depends on MCUX_HAS_COMPONENT_driver.lpc_i2c

        config MCUX_COMPONENT_component.lpi2c_adapter
            bool "lpi2c"
            help
                Enable component.lpi2c_adapter component
            select MCUX_COMPONENT_driver.lpi2c if MCUX_HAS_COMPONENT_driver.lpi2c
            select MCUX_COMPONENT_driver.lpflexcomm_lpi2c if MCUX_HAS_COMPONENT_driver.lpflexcomm_lpi2c
            depends on MCUX_HAS_DEPENDENCY_component.lpi2c_adapter

        config MCUX_COMPONENT_component.i3c_adapter
            bool "i3c"
            help
                Enable component.i3c_adapter component
            select MCUX_COMPONENT_driver.i3c
            depends on MCUX_HAS_COMPONENT_driver.i3c

        config MCUX_COMPONENT_component.dsc_i2c_adapter
            bool "dsc_i2c"
            help
                Enable component.dsc_i2c_adapter component
            select MCUX_COMPONENT_driver.dsc_i2c
            depends on MCUX_HAS_COMPONENT_driver.dsc_i2c

    endchoice
endif

rsource "muxes/Kconfig"
```

## mcux/mcux-sdk-ng/components/i2c/muxes/Kconfig
```kconfig
# Copyright 2024-2025 NXP
# SPDX-License-Identifier: BSD-3-Clause

menuconfig MCUX_COMPONENT_component.i2c_mux
        bool "I2C Multiplexer/Switch"

config MCUX_COMPONENT_component.i2c_mux_pca954x
        bool
        depends on MCUX_COMPONENT_component.i2c_mux
        default y
        help
          If you select this option you get support for NXP PCA954x/PCA984x
          and Maxim MAX735x/MAX736x I2C mux/switch devices.

if MCUX_COMPONENT_component.i2c_mux_pca954x
        config MCUX_COMPONENT_component.enable_max7356
            bool "MAX7356"
            help
                Enable MAX7356
        config MCUX_COMPONENT_component.enable_max7357
            bool "MAX7357"
            help
                Enable MAX7357
        config MCUX_COMPONENT_component.enable_max7358
            bool "MAX7358"
            help
                Enable MAX7358
        config MCUX_COMPONENT_component.enable_max7367
            bool "MAX7367"
            help
                Enable MAX7367
        config MCUX_COMPONENT_component.enable_max7368
            bool "MAX7368"
            help
                Enable MAX7368
        config MCUX_COMPONENT_component.enable_max7369
            bool "MAX7369"
            help
                Enable MAX7369
        config MCUX_COMPONENT_component.enable_pca9540
            bool "PCA9540"
            help
                Enable PCA9540
        config MCUX_COMPONENT_component.enable_pca9542
            bool "PCA9542"
            help
                Enable PCA9542
        config MCUX_COMPONENT_component.enable_pca9543
            bool "PCA9543"
            help
                Enable PCA9543
        config MCUX_COMPONENT_component.enable_pca9544
            bool "PCA9544"
            help
                Enable PCA9544
        config MCUX_COMPONENT_component.enable_pca9545
            bool "PCA9545"
            help
                Enable PCA9545
        config MCUX_COMPONENT_component.enable_pca9546
            bool "PCA9546"
            help
                Enable PCA9546
        config MCUX_COMPONENT_component.enable_pca9547
            bool "PCA9547"
            help
                Enable PCA9547
        config MCUX_COMPONENT_component.enable_pca9548
            bool "PCA9548"
            help
                Enable PCA9548
        config MCUX_COMPONENT_component.enable_pca9646
            bool "PCA9646"
            help
                Enable PCA9646
        config MCUX_COMPONENT_component.enable_pca9846
            bool "PCA9846"
            help
                Enable PCA9846
        config MCUX_COMPONENT_component.enable_pca9847
            bool "PCA9847"
            help
                Enable PCA9847
        config MCUX_COMPONENT_component.enable_pca9848
            bool "PCA9848"
            help
                Enable PCA9848
        config MCUX_COMPONENT_component.enable_pca9849
            bool "PCA9849"
            help
                Enable PCA9849
        config MCUX_COMPONENT_component.at_least_one_i2c_mux_device_enabled
            bool
            default y if MCUX_COMPONENT_component.enable_max7356 || \
                         MCUX_COMPONENT_component.enable_max7357 || \
                         MCUX_COMPONENT_component.enable_max7358 || \
                         MCUX_COMPONENT_component.enable_max7367 || \
                         MCUX_COMPONENT_component.enable_max7368 || \
                         MCUX_COMPONENT_component.enable_max7369 || \
                         MCUX_COMPONENT_component.enable_pca9540 || \
                         MCUX_COMPONENT_component.enable_pca9542 || \
                         MCUX_COMPONENT_component.enable_pca9543 || \
                         MCUX_COMPONENT_component.enable_pca9544 || \
                         MCUX_COMPONENT_component.enable_pca9545 || \
                         MCUX_COMPONENT_component.enable_pca9546 || \
                         MCUX_COMPONENT_component.enable_pca9547 || \
                         MCUX_COMPONENT_component.enable_pca9548 || \
                         MCUX_COMPONENT_component.enable_pca9646 || \
                         MCUX_COMPONENT_component.enable_pca9846 || \
                         MCUX_COMPONENT_component.enable_pca9847 || \
                         MCUX_COMPONENT_component.enable_pca9848 || \
                         MCUX_COMPONENT_component.enable_pca9849

        config MCUX_COMPONENT_component.i2c_mux_device_selection_err
            bool
            prompt "Error: At least one i2c mux device must be enabled"
            depends on !MCUX_COMPONENT_component.at_least_one_i2c_mux_device_enabled
            default y

endif
```

## mcux/mcux-sdk/drivers/ccm32k/Kconfig
```kconfig
# Copyright 2023 NXP
# All rights reserved.
#
# SPDX-License-Identifier: BSD-3-Clause

# driver_ccm32k
config MCUX_HAS_driver_ccm32k
    bool

config MCUX_USE_driver_ccm32k
    depends on MCUX_HAS_driver_ccm32k
    bool "ccm32k Driver"
    select MCUX_USE_driver_common
    help
      ccm32k Driver
```

## samples/boards/rd_rw612_bga/nxp_mbedtls_psa_crypto_thread/Kconfig
```kconfig
# Copyright 2022-2024 NXP
# SPDX-License-Identifier: Apache-2.0

source "Kconfig.zephyr"
```

## samples/boards/rd_rw612_bga/nxp_mbedtls_psa_crypto_thread/sample.yaml
```yaml
sample:
  name: nxp mbedtls psa crypto
common:
  tags:
    - crypto
    - mbedtls
tests:
  sample.boards.rd_rw612_bga.nxp_mbedtls_psa_crypto_thread:
    platform_allow:
      - rd_rw612_bga
    integration_platforms:
      - rd_rw612_bga
    harness: console
    harness_config:
      type: multi_line
      regex:
        - "Thread one was created successfully"
        - "Thread two was created successfully"
        - "Thread 1 is running."
        - "Thread 2 is running."
```

## samples/boards/rd_rw612_bga/nxp_mfg_bridge/Kconfig
```kconfig
# Copyright 2022-2024 NXP
# SPDX-License-Identifier: Apache-2.0

config SUPPORT_BLE_15D4
	bool "Support IEEE 802154"
	imply MONOLITHIC_IEEE802154

config SUPPORT_BLE
	bool "Support bluetooth low energy"
	default y
	imply NXP_MONOLITHIC_BT

config SUPPORT_WIFI
	bool "Support WiFi"
	default y
	imply NXP_MONOLITHIC_WIFI

source "Kconfig.zephyr"
```

## samples/boards/rd_rw612_bga/nxp_mfg_bridge/sample.yaml
```yaml
sample:
  name: nxp manufacture bridge
common:
  tags: wifi
tests:
  sample.boards.rd_rw612_bga.nxp_mfg_bridge:
    build_only: true
    platform_allow:
      - rd_rw612_bga
    integration_platforms:
      - rd_rw612_bga
```
