## west.yml
```yaml
# The west manifest file (west.yml) for the NXP ZSDK
#
# The per-installation west configuration file, .west/config, sets the
# path to the project containing this file in the [manifest] section's
# "path" variable.
#
# You are free to create your own manifest files and put them in any
# repository you want, to create your own custom Zephyr installations.
# For example, you could create a manifest file in your own out of
# tree application directory, which would pull this zephyr repository
# in as an ordinary project.
#
# You can pass your manifest repositories to west init when creating a
# new Zephyr installation. See the west documentation for more
# information.
#
#     [manifest]
#     path = zsdk
#
manifest:
  version: "1.2"

  # "remotes" is a list of locations where git repositories are cloned
  # and fetched from.
  remotes:
    - name: nxp
      url-base: https://github.com/NXP
    - name: nxp-zsdk
      url-base: https://github.com/nxp-zephyr
    - name: zephyrproject
      url-base: https://github.com/zephyrproject-rtos

  # If not otherwise specified, the projects below should be obtained
  # from the zsdk remote.
  defaults:
    remote: nxp-zsdk

  group-filter: [+optional, -bifrost]

  # "projects" is a list of git repositories to populate NXP Zephyr downstream
  # workspace.
  projects:

    - name: zephyr
      repo-path: nxp-zephyr
      revision: 0e9f8371a4a4de18f2396ceabae818791eeea101
      import:
        #
        # ZSDK imports the contents of nxp-zephyr/west.yml at the above
        # revision. Only the projects explicitly named in the
        # following allowlist are imported.
        #
        # If there is an override of one of the Zephyr modules,
        # remove it from the name-allowlist and add the project
        # explicitly below the list.
        #
        name-allowlist:
          - TraceRecorderSource
          - canopennode
          - chre
          - cmsis
          - cmsis-dsp
          - cmsis-nn
          - edtt
          - fatfs
          - hal_nxp
          - hal_st
          - hal_xtensa
          - liblc3
          - libmetal
          - littlefs
          - loramac-node
          - lvgl
          - lz4
          - mcuboot
          - mipi-sys-t
          - net-tools
          - open-amp
          - picolibc
          - segger
          - tinycrypt
          - uoscore-uedhoc
          - zcbor
          - zscilib
          - openthread

    # For internal NXP development support
    - name: bifrost
      west-commands: scripts/west_commands.yml
      repo-path: bifrost
      revision: e390bef8b5425a5197dd78f71267c25522cdc936
      groups:
        - bifrost

    #
    # NXP based overrides of Zephyr modules and additional
    # added modules
    #
    - name: hal_nxp
      revision: d0e26e1de42530ca14ff7fed64b26b693e6def3b
      path: modules/hal/nxp
      groups:
        - hal
    - name: els_pkc
      remote: nxp
      repo-path: els_pkc
      revision: cf88d69e4f403b1184eaa4596790e77cf945f386
      path: modules/crypto/els_pkc
      groups:
        - crypto
    - name: psa_crypto_driver
      remote: nxp
      repo-path: psa_crypto_driver
      revision: db9f9ed6314e941ef22c1ff7099c7a4dc4ef0653
      path: modules/crypto/psa_crypto_driver
      groups:
        - crypto
    - name: mbedtls
      remote: nxp
      repo-path: nxp_mbedtls
      revision: 668bf81181b3e3a611789e4ac0d7a4c1ae684d66
      path: modules/crypto/mbedtls
      groups:
        - crypto
    - name: trusted-firmware-m
      remote: nxp
      repo-path: nxp_tf-m
      revision: 3a7c9c9fbfcf5ca170742fe65e5002f3b44a1903
      path: modules/tee/tf-m/trusted-firmware-m
      groups:
        - tee
    - name: psa-arch-tests
      remote: nxp
      repo-path: nxp_psa_arch_test
      revision: 32784fe0367394a6e70dfe1771e0301cb4ab76f3
      path: modules/tee/tf-m/psa-arch-tests
      groups:
        - tee
    - name: tf-m-tests
      revision: 502ea90105ee18f20c78f710e2ba2ded0fc0756e
      path: modules/tee/tf-m/tf-m-tests
      remote: zephyrproject
      groups:
        - tee
    - name: hostap
      repo-path: hostap
      revision: 7240b5fa9db18a090ac6bda9d9b0314f4bdce8cd
      path: modules/lib/hostap
    - name: wifi_nxp
      remote: nxp
      repo-path: wifi_nxp
      revision: 3e75761a840d7ebf4031fdf2dc4f133dab28efc1
      path: modules/hal/nxp/mcux/middleware/wifi_nxp
    - name: wifi_nb_fw
      remote: nxp
      repo-path: wifi_nb_fw
      revision: 6cb0373d660903fa292d830997d7df568ce6cd7c
      path: modules/hal/nxp/zephyr/blobs/
    - name: nxp_iot_agent
      remote: nxp
      repo-path: el2go-agent
      revision: ca18e9ec8dd18f91eb6bd2309b355b754f22a35d
      path: modules/lib/nxp_iot_agent

    # Add any additional third-party repositories.

  self:
    path: zsdk
    # Configure west extensions.
    #west-commands: scripts/west-commands.yml
```
